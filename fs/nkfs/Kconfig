## fs/nkfs/Kconfig
```kconfig
config NKFS
    bool "Nehir Kartal File System"
    default y
    help
        My file simple filesystem implementation
```

## my_sub_system/Kconfig
```kconfig
config MY_SUB_SYSTEM
    bool "My Custom Subsytem"
    default n
    help
        My subsystem to test kernel development skills
```
